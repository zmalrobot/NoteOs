// SPDX-License-Identifier: GPL-2.0
/*
 * Samsung's Galaxy Note 10.1 - N8000 (3G version)
 *
 * Copyright (c) 2013 Samsung Electronics Co., Ltd.
 *		http://www.samsung.com
 */

/dts-v1/;
#include "exynos4412-p4note.dtsi"

/ {
	model = "Samsung Galaxy Note 10.1 (GT-N8000) based on Exynos4412";
	compatible = "samsung,n8000", "samsung,p4note", "samsung,exynos4412", "samsung,exynos4";
	chassis-type = "tablet";

	reserved-memory {
		#address-cells = <1>;
		#size-cells = <1>;
		ranges;

		ramoops: ramoops@46500000 {
			compatible = "ramoops";
			reg = <0x46500000 0x100000>;
			record-size = <0x20000>;
			console-size = <0x40000>;
			pmsg-size = <0x20000>;
		};
	};
};

